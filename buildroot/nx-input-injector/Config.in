## buildroot/nx-input-injector/Config.in
```kconfig
config BR2_PACKAGE_NX_INPUT_INJECTOR
	bool "nx-input-injector"
	select BR2_PACKAGE_XDOTOOL_NX
	help
	  X input events injection utiliity
```

## buildroot/nx_remote_controller_mod_defconfig
```kconfig
BR2_arm=y
BR2_cortex_a9=y
BR2_ARM_ENABLE_NEON=y
BR2_ARM_ENABLE_VFP=y
BR2_ARM_EABI=y
BR2_ARM_FPU_VFPV3=y
BR2_CCACHE=y
BR2_SHARED_STATIC_LIBS=y
BR2_KERNEL_HEADERS_3_4=y
BR2_TOOLCHAIN_BUILDROOT_GLIBC=y
# BR2_TARGET_GENERIC_GETTY is not set
# BR2_TARGET_GENERIC_REMOUNT_ROOTFS_RW is not set
BR2_PACKAGE_STRACE=y
BR2_PACKAGE_XORG7=y
BR2_PACKAGE_XAPP_XEV=y
BR2_PACKAGE_XDOTOOL=y
BR2_PACKAGE_OPENSSL=y
```

## externals/buildroot/nx_remote_controller_mod_defconfig
```kconfig
BR2_arm=y
BR2_cortex_a9=y
BR2_ARM_ENABLE_NEON=y
BR2_ARM_ENABLE_VFP=y
BR2_ARM_EABI=y
BR2_ARM_FPU_VFPV3=y
BR2_CCACHE=y
BR2_SHARED_STATIC_LIBS=y
BR2_KERNEL_HEADERS_3_4=y
BR2_TOOLCHAIN_BUILDROOT_GLIBC=y
BR2_TOOLCHAIN_BUILDROOT_CXX=y
# BR2_TARGET_GENERIC_GETTY is not set
# BR2_TARGET_GENERIC_REMOUNT_ROOTFS_RW is not set
BR2_PACKAGE_STRACE=y
BR2_PACKAGE_IMAGEMAGICK=y
BR2_PACKAGE_XORG7=y
BR2_PACKAGE_XAPP_XWD=y
BR2_PACKAGE_XAPP_XWININFO=y
BR2_PACKAGE_YAD=y
BR2_PACKAGE_XEV_NX=y
BR2_PACKAGE_NX_INPUT_INJECTOR=y
BR2_PACKAGE_JPEG=y
BR2_PACKAGE_LIBGTK2=y
```

## xev-nx/Config.in
```kconfig
config BR2_PACKAGE_XEV_NX
	bool "xev-nx"
	select BR2_PACKAGE_XLIB_LIBX11
	select BR2_PACKAGE_XLIB_LIBXRANDR
	select BR2_PACKAGE_XDOTOOL_NX
	help
	  print contents of X events
```
